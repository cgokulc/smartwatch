#include <Arduino.h>
#include <U8g2lib.h>
#include <Adafruit_MPU6050.h>
#include <Adafruit_Sensor.h>
#include <Wire.h>


Adafruit_MPU6050 mpu;

U8G2_SSD1306_128X64_NONAME_F_HW_I2C u8g2(U8G2_R0, /* clock=*/ SCL, /* data=*/ SDA, /* reset=*/ U8X8_PIN_NONE);  // High speed I2C
 
// U8G2_SSD1306_128X64_NONAME_F_SW_I2C u8g2(U8G2_R0, /* clock=*/ SCL, /* data=*/ SDA, /* reset=*/ U8X8_PIN_NONE);    //Low spped I2C

unsigned char rev(unsigned char a){
  return(((a&0b00000001)<<7)|((a&0b00000010)<<5)|((a&0b00000100)<<3)|((a&0b00001000)<<1)|((a&0b00010000)>>1)|((a&0b00100000)>>3)|((a&0b01000000)>>5)|((a&0b10000000)>>7));
}

unsigned char logo [] PROGMEM = {
0x00,0x00,0x3F,0xF0,0x00,0x00,
0x00,0x01,0xFF,0xFE,0x00,0x00,
0x00,0x0F,0xFF,0xFF,0xC0,0x00,
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0x00,0x00,0x3F,0xF0,0x00,0x00
};
unsigned char logo2 [1024] PROGMEM;
int i=0;

char buffer[6]; 

void setup(void) {
  u8g2.begin();
  mpu.begin();
  mpu.setAccelerometerRange(MPU6050_RANGE_16_G);
  mpu.setGyroRange(MPU6050_RANGE_250_DEG);
  mpu.setFilterBandwidth(MPU6050_BAND_21_HZ);
  int i=0;
  for(i=0;i<sizeof(logo);i++)
  {
    logo2[i] = rev(logo[i]);
  }
  u8g2.clearBuffer();
  u8g2.setDrawColor(1);
  u8g2.setBitmapMode(0);
  u8g2.drawXBM(40 ,8 , 48, 48,  logo2);
  u8g2.sendBuffer();
  delay(1000);
  
}
 
void loop(void) {
  u8g2.clearBuffer();
  u8g2.setFont(u8g2_font_ncenB10_tr);
  sensors_event_t a, g, temp;
  mpu.getEvent(&a, &g, &temp);
  if(analogRead(32)>3000)
  {
    while(analogRead(32)>3000){
      delay(10);
    }
    i++;
  }
  else if(analogRead(32)<1000)
  {
    while(analogRead(32)<1000){
      delay(50);
    }
    i--;
  }
 
  //dtostrf(f, 4 /*total length*/, 2 /*precision*/, buffer); 
  //u8g2.print(buffer);
  u8g2.setCursor(10,45);
  u8g2.print(i);
  u8g2.sendBuffer();
  delay(100);
}
